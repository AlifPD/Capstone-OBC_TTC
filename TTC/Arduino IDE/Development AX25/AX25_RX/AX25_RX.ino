uint8_t AX25_FRAME_PRE_CRC[272] = {
0x71,
0x25,
0x79,
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0xFF,
0xFF
};

char DST_ADDRESS[6];
char SRC_ADDRESS[6];
byte DST_SSID;
byte SRC_SSID;
byte iField[256] = {0xFF};
byte FLAG;
byte CONTROL;
byte PID;
uint16_t crcValue;

void setup() {
  Serial.begin(115200);
  int index = 0;

  for(int i=0; i<7; i++){
    if(i != 6){
      DST_ADDRESS[i] = (reverseBits(AX25_FRAME_PRE_CRC[index++]))>>1;
    }else{
      DST_SSID = reverseBits(AX25_FRAME_PRE_CRC[index++]);
    }
  }

  for(int i=0; i<7; i++){
    if(i != 6){
      SRC_ADDRESS[i] = (reverseBits(AX25_FRAME_PRE_CRC[index++]))>>1;
    }else{
      SRC_SSID = reverseBits(AX25_FRAME_PRE_CRC[index++]);
    }
  }

  CONTROL = reverseBits(AX25_FRAME_PRE_CRC[index++]);
  PID = reverseBits(AX25_FRAME_PRE_CRC[index++]);

  for(int i=0; i<sizeof(iField); i++){
    iField[i] = reverseBits(AX25_FRAME_PRE_CRC[index++]);
  }

  crcValue = calculateCRC(AX25_FRAME_PRE_CRC, sizeof(AX25_FRAME_PRE_CRC));

  Serial.print("DATA RECEIVED : [");
  for(int i=0; i<sizeof(AX25_FRAME_PRE_CRC); i++){
    Serial.print(" ");
    Serial.print(AX25_FRAME_PRE_CRC[i], HEX);
  }
  Serial.println("]");
  
  Serial.print("DST ADDRESS : [");
  for(int i=0; i<sizeof(DST_ADDRESS); i++){
    Serial.print(" ");
    Serial.print(DST_ADDRESS[i]);
  }
  Serial.println("]");

  Serial.print("DST SSID : [");
  Serial.print(DST_SSID, HEX);
  Serial.println("]");

  Serial.print("SRC ADDRESS : [");
  for(int i=0; i<sizeof(SRC_ADDRESS); i++){
    Serial.print(" ");
    Serial.print(SRC_ADDRESS[i]);
  }
  Serial.println("]");

  Serial.print("SRC SSID : [");
  Serial.print(SRC_SSID, HEX);
  Serial.println("]");

  Serial.print("CONTROL : [");
  Serial.print(CONTROL, HEX);
  Serial.println("]");

  Serial.print("PID : [");
  Serial.print(PID, HEX);
  Serial.println("]");

  Serial.print("Info Field : [");
  for(int i=0; i<sizeof(iField); i++){
    Serial.print(" ");
    Serial.print(iField[i], HEX);
  }
  Serial.println("]");

  Serial.print("CRC : [");
  Serial.print(crcValue, HEX);
  Serial.println("]");
}

void loop() {
  
}

byte reverseBits(byte b) {
  byte reversed = 0;
  
  for (int i = 0; i < 8; i++) {
    reversed <<= 1;
    reversed |= (b & 1);
    b >>= 1;
  }
  
  return reversed;
}

uint16_t calculateCRC(const byte* data, size_t length){
  uint16_t crc = 0xFFFF;

  for (size_t i = 0; i < length; ++i) {
    crc ^= data[i] << 8;

    for (byte bit = 0; bit < 8; ++bit) {
      if (crc & 0x8000) {
        crc = (crc << 1) ^ 0x1021; 
      } else {
        crc <<= 1;
      }
    }
  }

  return crc;
}